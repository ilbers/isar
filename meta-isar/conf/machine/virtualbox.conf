## meta-isar/conf/machine/virtualbox.conf
```bitbake
# This software is a part of ISAR.
# Copyright (c) Siemens AG, 2020
#
# SPDX-License-Identifier: MIT

DISTRO_ARCH ?= "amd64"

KERNEL_NAME ?= "amd64"

WKS_FILE ?= "sdimage-efi"

IMAGER_INSTALL:wic += "${GRUB_BOOTLOADER_INSTALL}"

VMDK_SUBFORMAT = "monolithicSparse"
IMAGE_FSTYPES ?= "ova"
```

## meta-isar/conf/machine/vmware.conf
```bitbake
# This software is a part of ISAR.
# Copyright (c) Siemens AG, 2020
#
# SPDX-License-Identifier: MIT

DISTRO_ARCH ?= "amd64"

KERNEL_NAME ?= "amd64"

WKS_FILE ?= "sdimage-efi"

IMAGER_INSTALL:wic += "${GRUB_BOOTLOADER_INSTALL}"

OVF_TEMPLATE_FILE ?= "vm-img-vmware.ovf.tmpl"

VMDK_SUBFORMAT = "streamOptimized"
IMAGE_FSTYPES ?= "ova"
```

## meta-isar/conf/machine/x86-pc.conf
```bitbake
#
# Copyright (c) Siemens AG, 2024
#
# SPDX-License-Identifier: MIT

DISTRO_ARCH ?= "amd64"

KERNEL_NAME ?= "amd64"

IMAGE_FSTYPES ?= "wic"
WKS_FILE ?= "efi-plus-pcbios"

IMAGER_INSTALL:wic += " \
    ${GRUB_BOOTLOADER_INSTALL} \
    ${SYSLINUX_BOOTLOADER_INSTALL}"
```

## meta-isar/scripts/lib/wic/canned-wks/bananapi.wks
```
part u-boot --source rawcopy --sourceparams "file=/usr/lib/u-boot/Bananapi/u-boot-sunxi-with-spl.bin" --no-table --align 8

part --source rootfs-u-boot --ondisk mmcblk0 --sourceparams="root=/dev/mmcblk0p1" --fstype ext4 --mkfs-extraopts "-T default" --label platform --align 1024

bootloader --append "rootwait"
```

## meta-isar/scripts/lib/wic/canned-wks/de0-nano-soc.wks
```
#
# Copyright (c) Siemens AG, 2018
#
# SPDX-License-Identifier: MIT

part --source rawcopy --sourceparams "file=/usr/lib/u-boot/de0-nano-soc/u-boot-with-spl.sfp" --system-id 0xa2 --align 1

part / --source rootfs-u-boot --ondisk mmcblk0 --fstype ext4 --label platform --align 1024 --active

bootloader --append "rw rootwait"
```

## meta-isar/scripts/lib/wic/canned-wks/efi-plus-pcbios.wks
```
# Example to show how to create an efi + pcbios image
# Note, that the loader argument is mandatory. But systemd-boot also works.
part /boot --source bootimg-biosplusefi-isar --sourceparams="loader=grub-efi" --label boot --part-type EF00 --active --align 1024 --use-uuid
part / --source rootfs --fstype=ext4 --mkfs-extraopts "-T default" --label platform --align 1024 --use-uuid --exclude-path=boot

bootloader --ptable gpt --timeout 3 --append "rootwait console=ttyS0,115200 console=tty0"
```

## meta-isar/scripts/lib/wic/canned-wks/hikey.wks
```
#
# Copyright (c) Siemens AG, 2018
#
# SPDX-License-Identifier: MIT

part /boot --source bootimg-efi-isar --sourceparams "loader=grub-efi" --ondisk mmcblk1 --label efi --part-type EF00 --align 1024

part / --source rootfs --ondisk mmcblk1 --fstype ext4 --mkfs-extraopts "-T default" --label platform --align 1024 --use-uuid --exclude-path boot/ --fsuuid 1f55d66a-40d8-11ee-be56-0242ac120002

bootloader --ptable gpt --timeout=3
```

## meta-isar/scripts/lib/wic/canned-wks/installer-rpi.wks
```
# short-description: Create installer image for RPi machines

part /boot --source bootimg-partition --fstype=vfat --label boot --active --align 4096 --size 10 --use-uuid
part / --source rootfs --fstype ext4 --exclude-path=install --label installroot --align 4096 --exclude-path=boot --use-uuid
part /install --source rootfs --change-directory=install --label INSTALLDATA --size 4G --fstype=vfat --use-uuid --align 4096

bootloader
```

## meta-isar/scripts/lib/wic/canned-wks/multipart-efi.wks
```
# Example showing how to split a single rootfs across partitions
part /boot --ondisk sda --source bootimg-efi-isar --sourceparams="loader=grub-efi" --label boot --active --align 1024
# when excluding paths, just specify --exclude-path once and separate paths using spaces
part /     --ondisk sda --source rootfs --fstype=ext4 --mkfs-extraopts "-T default" --label platform --align 1024 --exclude-path boot home --extra-space 1G
# put home last to support auto-expand of this partition
part /home --ondisk sda --source rootfs --rootfs-dir=${IMAGE_ROOTFS}/home --fstype=ext4 --mkfs-extraopts "-T default" --label home --align 1024

bootloader --ptable gpt --timeout 3 --append "rootwait console=ttyS0,115200 console=tty0"
```

## meta-isar/scripts/lib/wic/canned-wks/qemudefault.wks
```
# short-description: Create qcow2 image for QEMU machines

part / --source rootfs --fstype=ext4 --label root --align 4096 --size 4G

bootloader
```

## meta-isar/scripts/lib/wic/canned-wks/rpi-arm64-v8-efi.wks
```
part /boot --source bootimg-efi-isar --use-uuid --sourceparams "loader=systemd-boot" --label efi --part-type EF00 --align 8192 --size 256M
part /     --source rootfs --use-uuid --fstype ext4 --mkfs-extraopts "-T default" --label platform --align 8192 --exclude-path boot/ --extra-space 1G

bootloader --ptable gpt --timeout 3 --append "rootwait console=ttyS1,115200 module_blacklist=vc4"
```

## meta-isar/scripts/lib/wic/canned-wks/rpi-sdimg.wks
```
part /boot --source bootimg-partition --ondisk mmcblk0 --fstype=vfat --label boot --active --align 4096 --size 10

part / --source rootfs --ondisk mmcblk0 --fstype=ext4 --mkfs-extraopts "-T default" --label root --align 4096 --exclude-path=boot --fsuuid 1f55d66a-40d8-11ee-be56-0242ac120002

bootloader
```

## meta-isar/scripts/lib/wic/canned-wks/sdimage-efi-btrfs.wks
```
# short-description: Create an EFI disk image without any swap and btrfs
# long-description: Creates a partitioned EFI disk image without any swap that
# the user can directly dd to boot media, where the last partition is btrfs.

part /boot --source bootimg-efi-isar --sourceparams "loader=systemd-boot" --ondisk sda --label efi --part-type EF00 --align 1024

part / --source rootfs --ondisk sda --fstype btrfs --label platform --align 1024 --use-uuid --exclude-path boot/

include expand-padding.wks.inc

bootloader --ptable gpt --timeout 3 --append "rootwait console=ttyS0,115200 console=tty0"
```

## meta-isar/scripts/lib/wic/canned-wks/sdimage-efi-sb-debian.wks
```
# short-description: Create an EFI disk image using the debian secure boot chain
# long-description: Creates a partitioned EFI disk image without any swap that
# can be bootet on any UEFI with secure boot enabled and MS keys enrolled.
# Note, that this only works with grub and on amd64

part /boot --source bootimg-efi-isar --sourceparams "loader=grub-efi,use-debian-sb-stub=true" --ondisk sda --label efi --part-type EF00 --align 1024

part / --source rootfs --ondisk sda --fstype ext4 --mkfs-extraopts "-T default" --label platform --align 1024 --use-uuid --exclude-path boot/ --fsuuid 1f55d66a-40d8-11ee-be56-0242ac120002

bootloader --ptable gpt --timeout 3 --append "rootwait console=ttyS0,115200 console=tty0"
```

## meta-isar/scripts/lib/wic/canned-wks/sdimage-efi.wks
```
# short-description: Create an EFI disk image without any swap
# long-description: Creates a partitioned EFI disk image without any swap that
# the user can directly dd to boot media.

part /boot --source bootimg-efi-isar --sourceparams "loader=grub-efi" --ondisk sda --label efi --part-type EF00 --align 1024

part / --source rootfs --ondisk sda --fstype ext4 --mkfs-extraopts "-T default" --label platform --align 1024 --use-uuid --exclude-path boot/ --fsuuid 1f55d66a-40d8-11ee-be56-0242ac120002

include expand-padding.wks.inc

bootloader --ptable gpt --timeout 3 --append "rootwait console=ttyS0,115200 console=tty0"
```

## meta-isar/scripts/lib/wic/canned-wks/sifive-fu540.wks
```
#
# Copyright (c) Siemens AG, 2020
#
# SPDX-License-Identifier: MIT

part --source rawcopy --sourceparams "file=/usr/lib/opensbi/sifive-fu540/fw_payload.bin" --ondisk mmcblk0 --fixed-size 8M --align 1 --part-type 2e54b353-1271-4842-806f-e436d6af6985

part / --source rootfs-u-boot --ondisk mmcblk0 --fstype ext4 --mkfs-extraopts "-T default" --label platform --active --align 1024 --sourceparams "no_initrd=yes,script_prepend=setenv fdtfile sifive/hifive-unleashed-a00.dtb"

bootloader --ptable gpt --append "rootwait"
```

## meta-test/conf/layer.conf
```bitbake
# This software is a part of ISAR.
# Copyright (C) 2023 ilbers GmbH

# We have a conf and classes directory, add to BBPATH
BBPATH .= ":${LAYERDIR}"

# We have recipes-* directories, add to BBFILES
BBFILES += "${LAYERDIR}/recipes-*/*/*.bb ${LAYERDIR}/recipes-*/*/*.bbappend"

BBFILE_COLLECTIONS += "test"
BBFILE_PATTERN_test = "^${LAYERDIR}/"
BBFILE_PRIORITY_test = "10"

# This should only be incremented on significant changes that will
# cause compatibility issues with other layers
LAYERVERSION_test = "1"
LAYERSERIES_COMPAT_test = "v0.6"

LAYERDIR_test = "${LAYERDIR}"
LAYERDIR_test[vardepvalue] = "meta-test"
```

## meta-test/conf/local.conf.sample
```bitbake
# This software is a part of ISAR.
# Copyright (C) 2023 ilbers GmbH

# Machine and distro selection
MACHINE ??= "qemuarm"
DISTRO ??= "debian-bullseye"
DISTRO_ARCH ??= "armhf"

# The list of known multiple configurations
include ${LAYERDIR_isar}/conf/mc.conf

# Disable interactive patch resolution
PATCHRESOLVE = "noop"

# Disk Space Monitoring settings
BB_DISKMON_DIRS = "\
    STOPTASKS,${TMPDIR},1G,100K \
    STOPTASKS,${DL_DIR},1G,100K \
    STOPTASKS,${SSTATE_DIR},1G,100K \
    STOPTASKS,/tmp,100M,100K \
    HALT,${TMPDIR},100M,1K \
    HALT,${DL_DIR},100M,1K \
    HALT,${SSTATE_DIR},100M,1K \
    HALT,/tmp,10M,1K"

# Isar and external MIRRORS in case of service unavailable
MIRRORS ?= "git?://salsa\.debian\.org/debian/.* git://github.com/ilbers/BASENAME"
MIRRORS += "https?://cdn\.kernel\.org/.* https://mirrors.edge.kernel.org/PATH"

# The default list of extra packages
IMAGE_INSTALL = "hello-isar example-raw example-module-${KERNEL_NAME} enable-fsck isar-exclude-docs samefile hello isar-disable-apt-cache cowsay example-prebuilt"

# Machines with secure boot should use signed modules
IMAGE_INSTALL:remove:qemuamd64-sb = "example-module-${KERNEL_NAME}"
IMAGE_INSTALL:append:qemuamd64-sb = " example-module-signed-${KERNEL_NAME}"

# Users and groups
USERS += "root"
USER_root[password] ??= "$6$rounds=10000$RXeWrnFmkY$DtuS/OmsAS2cCEDo0BF5qQsizIrq6jPgXnwv3PHqREJeKd1sXdHX/ayQtuQWVDHe0KIO0/sVH8dvQm1KthF0d/"

GROUPS += "isar"
GROUP_isar[flags] = "system"

USERS += "isar"
USER_isar[gid] = "isar"
USER_isar[home] = "/var/lib/isar"
USER_isar[comment] = "My isar user"
USER_isar[flags] = "system create-home"
USER_isar[password] = "isar"
USER_isar[flags] += "clear-text-password"
```

## meta/conf/distro/debian-bookworm.conf
```bitbake
# This software is a part of ISAR.

require debian-common.conf

BASE_DISTRO_CODENAME = "bookworm"

HOST_DISTRO ?= "debian-${BASE_DISTRO_CODENAME}"

DISTRO_CONFIG_SCRIPT ?= "debian-configscript.sh"
DISTRO_KERNELS ?= "4kc-malta 5kc-malta 686 686-pae amd64 arm64 armmp \
        armmp-lpae cloud-amd64 cloud-arm64 loongson-3 marvell mips32r2el \
        mips64r2el octeon powerpc64le rpi rt-686-pae rt-amd64 rt-arm64 \
        rt-armmp s390x"

DISTRO_GCC = "12"

DEBIAN_COMPAT = "13"
```

## meta/conf/distro/debian-bullseye.conf
```bitbake
# This software is a part of ISAR.

require debian-common.conf

BASE_DISTRO_CODENAME = "bullseye"

HOST_DISTRO ?= "debian-${BASE_DISTRO_CODENAME}"

DISTRO_APT_SOURCES ?= "conf/distro/debian-${BASE_DISTRO_CODENAME}.list"
DISTRO_CONFIG_SCRIPT ?= "debian-configscript.sh"
DISTRO_KERNELS ?= "4kc-malta 5kc-malta 686 686-pae amd64 arm64 armmp \
    armmp-lpae cloud-amd64 loongson-3 octeon powerpc64le rpi s390x marvell \
    rt-686-pae rt-amd64 rt-arm64 rt-armmp"

IMAGE_PREINSTALL += "init"

WIC_IMAGER_INSTALL += "python3-distutils"
```

## meta/conf/distro/debian-buster.conf
```bitbake
# This software is a part of ISAR.

require debian-common.conf

BASE_DISTRO_CODENAME = "buster"

HOST_DISTRO ?= "debian-buster"

DISTRO_CONFIG_SCRIPT ?= "debian-configscript.sh"
DISTRO_KERNELS ?= "4kc-malta 5kc-malta 686 686-pae amd64 arm64 armmp \
    armmp-lpae cloud-amd64 loongson-3 marvell octeon powerpc64le rpi s390x \
    rt-686-pae rt-amd64 rt-arm64 rt-armmp"

DISTRO_GCC = "8"

DEBIAN_COMPAT = "12"
```

## meta/conf/distro/debian-common.conf
```bitbake
# This software is a part of ISAR.
# Copyright (C) 2018 Siemens AG
#
# SPDX-License-Identifier: MIT

BASE_DISTRO = "debian"

HOST_BASE_DISTRO ?= "${BASE_DISTRO}"

HOST_DISTRO_APT_SOURCES ?= "conf/distro/${HOST_DISTRO}.list"
DISTRO_APT_SOURCES ?= "conf/distro/${BASE_DISTRO}-${BASE_DISTRO_CODENAME}.list"

IMAGE_PREINSTALL += "init"

WIC_IMAGER_INSTALL = "parted \
                      gdisk \
                      util-linux \
                      dosfstools \
                      mtools \
                      e2fsprogs \
                      python3-distutils \
                      bmap-tools \
                      tar \
                      fdisk"

GRUB_BOOTLOADER_INSTALL:amd64 = "grub-efi-amd64-bin"
GRUB_BOOTLOADER_INSTALL:i386 = "grub-efi-ia32-bin"
GRUB_BOOTLOADER_INSTALL:armhf = "grub-efi-arm-bin"
GRUB_BOOTLOADER_INSTALL:arm64 = "grub-efi-arm64-bin"

GRUB_DEBIAN_SB_CHAIN:amd64 = "grub-efi-amd64-signed shim-signed"
GRUB_DEBIAN_SB_MOK:amd64 = "shim-helpers-amd64-signed"

SYSLINUX_BOOTLOADER_INSTALL = "syslinux syslinux-common"

SYSTEMD_BOOTLOADER_INSTALL = "systemd:${DISTRO_ARCH}"
SYSTEMD_BOOTLOADER_INSTALL:debian-bookworm = "systemd-boot-efi:${DISTRO_ARCH}"
SYSTEMD_BOOTLOADER_INSTALL:debian-sid-ports = "systemd-boot-efi:${DISTRO_ARCH}"

COMPAT_DISTRO_ARCH:amd64 = "i386"
COMPAT_DISTRO_ARCH:arm64 = "armhf"
```

## meta/conf/distro/debian-sid-ports.conf
```bitbake
# This software is a part of ISAR.
#
# Copyright (c) Siemens AG, 2020
#
# SPDX-License-Identifier: MIT

require debian-common.conf

BASE_DISTRO_CODENAME = "sid"

HOST_DISTRO ?= "debian-sid"

DEBIAN_PORTS_KEYS += "https://www.ports.debian.org/archive_2023.key;sha256sum=a29b938b9f302dc7386cc77a743f50b1fe2a55eb17a9a22db938492047f59f3f"
DEBIAN_PORTS_KEYS += "https://www.ports.debian.org/archive_2024.key;sha256sum=d7c297ea226bb685ac68195d0b61078f8964a611136b11b9514babfa3b92c448"
DEBIAN_PORTS_KEYS += "https://www.ports.debian.org/archive_2025.key;sha256sum=2a729612c514fac719d142910b1d876c7abecba00df51f2b32041d530aeb41d6"

DISTRO_APT_SOURCES = "conf/distro/debian-${BASE_DISTRO_CODENAME}-ports.list"
DISTRO_BOOTSTRAP_KEYS += "${DEBIAN_PORTS_KEYS}"
DISTRO_CONFIG_SCRIPT ?= "debian-configscript.sh"
DISTRO_KERNELS ?= "riscv64"

HOST_DISTRO_APT_SOURCES += "${DISTRO_APT_SOURCES}"
THIRD_PARTY_APT_KEYS += "${DEBIAN_PORTS_KEYS}"

IMAGE_PREINSTALL += "init"

DEBIAN_COMPAT = "13"
```

## meta/conf/distro/debian-sid.conf
```bitbake
# This software is a part of ISAR.
#
# Copyright (c) Siemens AG, 2020-2023
#
# SPDX-License-Identifier: MIT

require debian-common.conf

BASE_DISTRO_CODENAME = "sid"

HOST_DISTRO ?= "debian-${BASE_DISTRO_CODENAME}"

DISTRO_CONFIG_SCRIPT ?= "debian-configscript.sh"
DISTRO_KERNELS ?= "5kc-malta 686 686-pae alpha-generic alpha-smp amd64 arm64 \
        armmp armmp-lpae cloud-amd64 cloud-arm64 itanium loongson-3 m68k \
        mckinley mips64r2el mips64r6el octeon parisc parisc64 powerpc64 \
        powerpc64-64k powerpc64le powerpc64le-64k riscv64 rpi rt-686-pae \
        rt-amd64 rt-arm64 rt-armmp s390x sh7751r sh7785lcr sparc64 sparc64-smp"

DISTRO_GCC = "13"

DEBIAN_COMPAT = "13"
```
