## meta-isar/conf/machine/de0-nano-soc.conf
```bitbake
#
# Copyright (c) Siemens AG, 2018
#
# SPDX-License-Identifier: MIT

DISTRO_ARCH ?= "armhf"

KERNEL_NAME ?= "mainline"

U_BOOT_CONFIG:de0-nano-soc = "socfpga_de0_nano_soc_defconfig"
U_BOOT_BIN:de0-nano-soc = "u-boot-with-spl.sfp"

IMAGE_FSTYPES ?= "wic"
WKS_FILE ?= "de0-nano-soc.wks.in"
IMAGER_INSTALL:wic += "u-boot-de0-nano-soc"
IMAGER_BUILD_DEPS += "u-boot-de0-nano-soc"

IMAGE_INSTALL += "u-boot-tools libubootenv-tool u-boot-script"
```

## meta-isar/conf/machine/hikey.conf
```bitbake
#
# Copyright (c) Siemens AG, 2018
#
# SPDX-License-Identifier: MIT

DISTRO_ARCH = "arm64"

KERNEL_NAME ?= "mainline"

IMAGE_FSTYPES = "wic-img"
WKS_FILE ?= "hikey"
IMAGER_INSTALL += "${GRUB_BOOTLOADER_INSTALL}"

IMAGE_PREINSTALL_append = " firmware-ti-connectivity"
```

## meta-isar/conf/machine/imx6-sabrelite.conf
```bitbake
# This software is a part of ISAR.
# Copyright (C) Siemens AG, 2019
#
# SPDX-License-Identifier: MIT

MACHINE_SERIAL ?= "ttymxc0"
BAUDRATE_TTY ?= "115200"

IMAGE_CLASSES += "ubi-ubifs-img"
MKUBIFS_ARGS := "-m 0x1000 -e 0x3e000 -c 1500"
UBINIZE_ARGS = "-vv -m 0x1000 -p 0x40000"
IMAGE_FSTYPES ?= "ubi-ubifs"

DTB_FILES = "imx6q-sabrelite.dtb"
```

## meta-isar/conf/machine/include/socfpga.inc
```bitbake
SOC_FAMILY = "socfpga"

require conf/machine/include/arm/armv7a/tune-cortexa9.inc

# this variable specifies the kernel to be built: linux-socfpga or linux-socfpga-ltsi
# this affects the PREFERRED_PROVIDER of virtual/kernel
# it can be overriden from the environment, using BB_ENV_EXTRAWHITE
KERNEL_PROVIDER ?= "linux-socfpga"
PREFERRED_PROVIDER_virtual/kernel ?= "${KERNEL_PROVIDER}"

PREFERRED_PROVIDER_virtual/bootloader ?= "u-boot-socfpga"
PREFERRED_PROVIDER_u-boot ?= "u-boot-socfpga"

# Increase this everytime you change something in the kernel
MACHINE_KERNEL_PR = "r1"

UBOOT_ENTRYPOINT = "0x80008000"
UBOOT_LOADADDRESS = "0x80008000"

KERNEL_IMAGETYPE ?= "zImage"
MACHINE_EXTRA_RRECOMMENDS = " kernel-modules"
MACHINE_FEATURES = "kernel26"

KBUILD_DEFCONFIG ?= "socfpga_defconfig"

# file system images required
IMAGE_FSTYPES ?= "cpio ext3 tar.gz jffs2"

# u-boot setup
UBOOT_SUFFIX ?= "sfp"
UBOOT_BINARY ?= "u-boot-with-spl.${UBOOT_SUFFIX}"

# Settings for ubifs
MKUBIFS_ARGS = "--leb-size 126976 --min-io-size 2048 --max-leb-cnt 3600"
UBINIZE_ARGS = "--peb-size 128KiB --min-io-size 2048 --sub-page-size 2048"

do_image_wic[depends] += "mtools-native:do_populate_sysroot dosfstools-native:do_populate_sysroot virtual/bootloader:do_deploy virtual/kernel:do_deploy"
```

## meta-isar/conf/machine/include/socfpga_armv8a.inc
```bitbake
require conf/machine/include/arm/arch-armv8a.inc

KERNEL_PROVIDER ?= "linux-socfpga"
PREFERRED_PROVIDER_virtual/kernel ?= "${KERNEL_PROVIDER}"
KERNEL_IMAGETYPE ?= "Image"
MACHINE_EXTRA_RRECOMMENDS += "kernel-modules"

KBUILD_DEFCONFIG ?= "defconfig"

PREFERRED_PROVIDER_virtual/bootloader ?= "u-boot-socfpga"
PREFERRED_PROVIDER_u-boot ?= "u-boot-socfpga"

SPL_BINARY ?= "spl/u-boot-spl-dtb.hex"
UBOOT_SUFFIX ?= "img"
UBOOT_BINARY ?= "u-boot.img"
UBOOT_ELF ?= "u-boot"

# UBOOT_IMAGE = "u-boot-${MACHINE}-${PV}-${PR}.${UBOOT_SUFFIX}"

# Settings for ubifs
MKUBIFS_ARGS = "--leb-size 126976 --min-io-size 2048 --max-leb-cnt 3600"
UBINIZE_ARGS = "--peb-size 128KiB --min-io-size 2048 --sub-page-size 2048"

IMAGE_FSTYPES ?= "cpio ext3 tar.gz"
do_image_wic[depends] += "mtools-native:do_populate_sysroot dosfstools-native:do_populate_sysroot virtual/bootloader:do_deploy virtual/kernel:do_deploy"
```

## meta-isar/conf/machine/include/tune-nios2.inc
```bitbake
#@TYPE: Machine configuration
#@NAME: nios2

DEFAULTTUNE ?= "nios2"

TUNE_ARCH = "nios2"
TUNE_PKGARCH = "${DEFAULTTUNE}"

# Nios2 R2
TUNEVALID[r2] = "Nios2 R2 support"
TUNECONFLICTS[r2] = "bigendian"
TUNE_CCARGS .= "${@bb.utils.contains("TUNE_FEATURES", "r2", " -march=r2", " -march=r1", d)}"

# Endianess
TUNEVALID[bigendian] = "Enable big-endian mode"
TUNECONFLICTS[bigendian] = "r2"
TUNE_CCARGS .= "${@bb.utils.contains("TUNE_FEATURES", "bigendian", " -meb", " -mel", d)}"

# Multiply opcodes
TUNEVALID[hw-mul] = "Enable Nios2 Hardware Multiply"
TUNEVALID[hw-mulx] = "Enable Nios2 Extended Hardware Multiply"

# Establish which Multiply output result size to use
TUNE_CCARGS .= "${@bb.utils.contains("TUNE_FEATURES", "hw-mul", " -mhw-mul", "" ,d)}"
TUNE_CCARGS .= "${@bb.utils.contains("TUNE_FEATURES", "hw-mulx", " -mhw-mulx", "" ,d)}"

NIOS2PKGMUL_BASIC = "${@bb.utils.contains("TUNE_FEATURES", "hw-mul", "-mul", "" ,d)}"
TUNE_PKGARCH .= "${@bb.utils.contains("TUNE_FEATURES", "hw-mulx", "-mulx", "${NIOS2PKGMUL_BASIC}" ,d)}"

# Divide opcodes
TUNEVALID[hw-div] = "Enable Nios2 hardware divider."
TUNE_CCARGS .= "${@bb.utils.contains("TUNE_FEATURES", "hw-div", " -mhw-div", "" ,d)}"
TUNE_PKGARCH .= "${@bb.utils.contains("TUNE_FEATURES", "hw-div", "-div", "" ,d)}"

# FPU support
TARGET_FPU = "fpu-other"
TUNEVALID[fpu-soft] = "Use Nios2 software FPU"
TUNEVALID[fpu-custom] = "Enable Nios2 hardware FPU"
TUNEVALID[fpu-customdiv] = "Enable Nios2 hardware FPU with divider"

# Establish which fpu is configured in TUNE_FEATURES. Soft is the default for gcc.
NIOS2CCARGSFPU_BASIC = "${@bb.utils.contains("TUNE_FEATURES", "fpu-custom", " -mcustom-fpu-cfg=60-1", "", d)}"
TUNE_CCARGS .= "${@bb.utils.contains("TUNE_FEATURES", "fpu-customdiv", " -mcustom-fpu-cfg=60-2", "${NIOS2CCARGSFPU_BASIC}", d)}"

NIOS2PKGFPU_BASIC = "${@bb.utils.contains("TUNE_FEATURES", "fpu-custom", "-fpu", "", d)}"
TUNE_PKGARCH .= "${@bb.utils.contains("TUNE_FEATURES", "fpu-customdiv", "-fpudiv", "${NIOS2PKGFPU_BASIC}", d)}"

TUNECONFLICTS[fpu-custom] = "fpu-soft fpu-customdiv"
TUNECONFLICTS[fpu-customdiv] = "fpu-soft fpu-custom"

# Nios2 R2 BMX opcodes
TUNEVALID[bmx] = "Enable Nios2 R2 Bit Manipulation Extension."
TUNECONFLICTS[bmx] = "nios2 bigendian"
TUNE_CCARGS .= "${@bb.utils.contains("TUNE_FEATURES", "bmx", " -mbmx", "" ,d)}"
TUNE_PKGARCH .= "${@bb.utils.contains("TUNE_FEATURES", "bmx", "-bmx", "" ,d)}"

# Nios2 R2 CDX opcodes
TUNEVALID[cdx] = "Enable Nios2 R2 Code Density Extension."
TUNECONFLICTS[cdx] = "nios2 bigendian"
TUNE_CCARGS .= "${@bb.utils.contains("TUNE_FEATURES", "cdx", " -mcdx", "" ,d)}"
TUNE_PKGARCH .= "${@bb.utils.contains("TUNE_FEATURES", "cdx", "-cdx", "" ,d)}"

# Architecture configuration
AVAILTUNES += "nios2 nios2eb nios2r2"

TUNEVALID[nios2] = "Nios2 R1 Little-Endian"
TUNE_FEATURES:tune-nios2 = "nios2"
PACKAGE_EXTRA_ARCHS:tune-nios2 = "${TUNE_PKGARCH}"

TUNEVALID[nios2eb] = "Nios2 R1 Big-Endian"
TUNE_FEATURES:tune-nios2eb = "bigendian"
PACKAGE_EXTRA_ARCHS:tune-nios2eb = "${TUNE_PKGARCH}"

TUNEVALID[nios2r2] = "Nios2 R2"
TUNE_FEATURES:tune-nios2r2 = "r2"
PACKAGE_EXTRA_ARCHS:tune-nios2r2 = "${TUNE_PKGARCH}"
```

## meta-isar/conf/machine/nand-ubi-demo.conf
```bitbake
# This software is a part of ISAR.
# Copyright (C) Siemens AG, 2019
#
# SPDX-License-Identifier: MIT

MACHINE_SERIAL ?= "ttymxc0"
BAUDRATE_TTY ?= "115200"

MKUBIFS_ARGS := "-m 0x1000 -e 0x3e000 -c 1500"
UBINIZE_ARGS = "-vv -m 0x1000 -p 0x40000"
IMAGE_TYPE ?= "ubi-ubifs-img"

DTB_FILES = "imx6q-sabrelite.dtb"
```

## meta-isar/conf/machine/nanopi-neo-efi.conf
```bitbake
# This software is a part of ISAR.
# Copyright (c) Siemens AG, 2023
#
# SPDX-License-Identifier: MIT

DISTRO_ARCH ?= "armhf"

KERNEL_NAME ?= "armmp"

IMAGE_FSTYPES ?= "wic"
WKS_FILE ?= "nanopi-neo-efi.wks.in"

IMAGER_INSTALL += "u-boot-sunxi ${SYSTEMD_BOOTLOADER_INSTALL}"
```

## meta-isar/conf/machine/nanopi-neo.conf
```bitbake
# This software is a part of ISAR.
# Copyright (c) Mentor, a Siemens business, 2020
#
# SPDX-License-Identifier: MIT

DISTRO_ARCH ?= "armhf"

KERNEL_NAME ?= "armmp"

IMAGE_FSTYPES ?= "wic"
WKS_FILE ?= "nanopi-neo.wks.in"

IMAGE_INSTALL += "u-boot-script"
IMAGER_INSTALL += "u-boot-sunxi"
```

## meta-isar/conf/machine/phyboard-mira.conf
```bitbake
# This software is a part of ISAR.
# Copyright (C) 2022 ilbers GmbH
#
# SPDX-License-Identifier: MIT

DISTRO_ARCH ?= "armhf"

KERNEL_NAME ?= "phy"

MACHINE_SERIAL ?= "ttymxc0"
BAUDRATE_TTY ?= "115200"

IMAGE_TYPEDEP:ubi += "ubifs"

MKUBIFS_ARGS := "-m 0x800 -e 0x1f000 -c 8012"
UBINIZE_ARGS = "-vv -m 0x800 -p 0x20000"
IMAGE_FSTYPES ?= "ubi ubifs"

DTB_FILES = "imx6q-phytec-mira-rdk-nand.dtb"

IMAGE_INSTALL += "barebox"

BAREBOX_CONFIG = "imx_v7_defconfig"
BAREBOX_ENV = "phytec-mira-env"
BAREBOX_BASE_BIN = "barebox-phytec-phycore-imx6q-som-nand-1gib"
```

## meta-isar/conf/machine/qemu-i386.conf
```bitbake
# This software is a part of ISAR.
# Copyright (C) 2015-2016 ilbers GmbH

IMAGE_PREINSTALL = "linux-image-3.16.0-4-686-pae"

KERNEL_IMAGE = "vmlinuz-3.16.0-4-686-pae"
INITRD_IMAGE = "initrd.img-3.16.0-4-686-pae"

MACHINE_SERIAL = "ttyS0"
ROOTFS_DEV = "sda"
BAUDRATE_TTY = "115200"

IMAGE_TYPE = "ext4-img"
```

## meta-isar/conf/machine/qemuamd64-cip.conf
```bitbake
# This software is a part of ISAR.
# Copyright (c) Siemens AG, 2024
#
# SPDX-License-Identifier: MIT

include conf/machine/qemuamd64.conf

KERNEL_NAME = "cip"
```

## meta-isar/conf/machine/qemuamd64-iso.conf
```bitbake
# This software is a part of ISAR.
# Copyright (C) 2025 Siemens AG

WKS_FILE ?= "isohybrid-efi.wks.in"
IMAGER_INSTALL:wic += " \
    ${SYSLINUX_BOOTLOADER_INSTALL} \
    syslinux-utils \
    isolinux \
    xorriso \
"

IMAGE_PREINSTALL += "live-boot"
IMAGE_INSTALL:remove = "expand-on-first-boot"
IMAGE_TYPEDEP:wic += "squashfs"
SQUASHFS_EXCLUDE_DIRS = "boot"

QEMU_DISK_ARGS ?= "-cdrom ##ROOTFS_IMAGE## -bios /usr/share/ovmf/OVMF.fd"

require conf/machine/qemuamd64.conf
```

## meta-isar/conf/machine/qemuamd64-sb.conf
```bitbake
# This software is a part of ISAR.
# Copyright (C) 2022 Siemens AG
# Copyright (C) 2023 ilbers GmbH

include conf/machine/qemuamd64.conf

WKS_FILE = "sdimage-efi-sb-debian"

# use bootloader with signed boot support
IMAGER_INSTALL:remove = "${GRUB_BOOTLOADER_INSTALL}"
IMAGER_INSTALL:wic += "${GRUB_DEBIAN_SB_CHAIN}"

# include public keys
IMAGE_INSTALL += "sb-mok-public"

# add MOK utilities to insert MOK into EFI
IMAGER_INSTALL:wic += "${GRUB_DEBIAN_SB_MOK}"
IMAGE_PREINSTALL += "mokutil"

# overwrite qemu disk args for signed boot
QEMU_DISK_ARGS = "-drive file=##ROOTFS_IMAGE##,format=raw -global driver=cfi.pflash01,property=secure,value=on -drive if=pflash,format=raw,unit=0,file=/usr/share/OVMF/OVMF_CODE_4M.ms.fd,readonly=on"
```

## meta-isar/conf/machine/qemuamd64.conf
```bitbake
# This software is a part of ISAR.
# Copyright (C) 2017 ilbers GmbH

DISTRO_ARCH ?= "amd64"

KERNEL_NAME ?= "amd64"

IMAGE_FSTYPES ?= "wic"
WKS_FILE ?= "sdimage-efi"
IMAGER_BOM:wic += "${GRUB_BOOTLOADER_INSTALL}"
IMAGER_INSTALL:wic += "${GRUB_BOOTLOADER_INSTALL}"

QEMU_ARCH ?= "x86_64"
QEMU_MACHINE ?= "q35"
QEMU_CPU ?= ""
QEMU_DISK_ARGS ?= "-hda ##ROOTFS_IMAGE## -bios /usr/share/ovmf/OVMF.fd"

MACHINE_SERIAL ?= "ttyS0"
BAUDRATE_TTY ?= "115200"
```

## meta-isar/conf/machine/qemuarm.conf
```bitbake
# This software is a part of ISAR.
# Copyright (C) 2015-2017 ilbers GmbH

DISTRO_ARCH ?= "armhf"

KERNEL_NAME ?= "armmp"

IMAGE_FSTYPES ?= "ext4"
ROOTFS_EXTRA ?= "128"

QEMU_ROOTFS_DEV ?= "vda"

QEMU_ARCH ?= "arm"
QEMU_MACHINE ?= "virt,highmem=off"
QEMU_CPU ?= "cortex-a15"
# TODO: start_vm doesn't support multiline vars
QEMU_DISK_ARGS ?= "-drive file=##ROOTFS_IMAGE##,if=none,format=raw,id=hd0 -device virtio-blk-device,drive=hd0"

MACHINE_SERIAL ?= "ttyAMA0"
BAUDRATE_TTY ?= "115200"
```

## meta-isar/conf/machine/qemui386.conf
```bitbake
# This software is a part of ISAR.
# Copyright (C) 2017 ilbers GmbH
DISTRO_ARCH ?= "i386"

KERNEL_NAME ?= "686-pae"

IMAGE_FSTYPES ?= "wic"
WKS_FILE ?= "directdisk-isar"
IMAGER_INSTALL:wic += "${SYSLINUX_BOOTLOADER_INSTALL}"

QEMU_ARCH ?= "i386"
QEMU_MACHINE ?= "pc"
QEMU_CPU ?= ""
QEMU_DISK_ARGS ?= "-hda ##ROOTFS_IMAGE##"

MACHINE_SERIAL ?= "ttyS0"
BAUDRATE_TTY ?= "115200"
```

## meta-isar/conf/machine/qemumipsel.conf
```bitbake
# This software is a part of ISAR.
# Copyright (C) 2019 Mentor Graphics, a Siemens business

MACHINE_SERIAL ?= "ttyS0"
BAUDRATE_TTY ?= "115200"

IMAGE_TYPE ?= "ext4-img"
```

## meta-isar/conf/machine/rpi-arm-v7.conf
```bitbake
# This software is a part of Isar.
# Copyright (C) 2022 ilbers GmbH

DISTRO_ARCH ?= "armhf"
KERNEL_NAME = "kernel7"

include conf/machine/rpi-common.conf
```

## meta-isar/conf/machine/rpi-arm64-v8-efi.conf
```bitbake
# This software is a part of Isar.
# Copyright (C) 2025 Siemens

require conf/machine/rpi-arm64-v8-efi.inc

IMAGER_INSTALL:wic += "${SYSTEMD_BOOTLOADER_INSTALL}"
```

## meta-isar/conf/machine/rpi-arm64-v8-efi.inc
```bitbake
# This software is a part of ISAR.
# Copyright (C) 2025 Siemens

DISTRO_ARCH ?= "arm64"
KERNEL_NAME ?= "arm64"

IMAGE_FSTYPES ?= "wic"
WKS_FILE ?= "rpi-arm64-v8-efi.wks"

IMAGER_BUILD_DEPS = "bootconfig-rpi-efi"
IMAGER_INSTALL:wic += "${IMAGER_BUILD_DEPS}"

IMAGE_EFI_BOOT_FILES = " \
    /usr/lib/bootconfig-rpi-efi/config.txt;config.txt \
    /usr/lib/u-boot/rpi_arm64/u-boot.bin;u-boot.bin \
    /usr/lib/rpi-firmware/fixup4.dat;fixup4.dat \
    /usr/lib/rpi-firmware/start4.elf;start4.elf \
    /usr/lib/rpi-firmware/overlays/*;overlays/ \
    ${IMAGE_ROOTFS}/usr/lib/linux-image-*/broadcom/bcm2711-rpi-4*.dtb \
"

IMAGE_PREINSTALL:append = " firmware-brcm80211"
```

## meta-isar/conf/machine/rpi.conf
```bitbake
# This software is a part of ISAR.
# Copyright (C) 2015-2017 ilbers GmbH

MACHINE_SERIAL ?= "ttyAMA0"
BAUDRATE_TTY ?= "9600"

IMAGE_FSTYPES ?= "rpi-sdimg"
```

## meta-isar/conf/machine/sifive-fu540.conf
```bitbake
#
# Copyright (c) Siemens AG, 2020
#
# SPDX-License-Identifier: MIT

DISTRO_ARCH = "riscv64"

KERNEL_NAME ?= "mainline"

IMAGE_FSTYPES ?= "wic"
WKS_FILE ?= "sifive-fu540"
IMAGER_INSTALL:wic += "opensbi-sifive-fu540"
IMAGER_BUILD_DEPS += "opensbi-sifive-fu540"

IMAGE_INSTALL += "u-boot-script"
```

## meta-isar/conf/machine/starfive-visionfive2.conf
```bitbake
#
# Copyright (c) Siemens AG, 2023
#
# SPDX-License-Identifier: MIT

DISTRO_ARCH = "riscv64"

KERNEL_NAME ?= "starfive"

IMAGE_FSTYPES ?= "wic"
WKS_FILE ?= "starfive-visionfive2.wks.in"
IMAGER_INSTALL:wic += " \
    u-boot-starfive-visionfive2 \
    ${SYSTEMD_BOOTLOADER_INSTALL}"
IMAGER_BUILD_DEPS += "u-boot-starfive-visionfive2"

# DTB file for booting
DTB_VISIONFIVE2 = "jh7110-starfive-visionfive-2-v1.3b.dtb"
DTB_FILES = "starfive/${DTB_VISIONFIVE2}"
```

## meta-isar/conf/machine/stm32mp15x.conf
```bitbake
#
# Copyright (c) Siemens AG, 2020
#
# SPDX-License-Identifier: MIT

DISTRO_ARCH ?= "armhf"

KERNEL_NAME ?= "mainline"

U_BOOT_CONFIG:stm32mp15x = "stm32mp15_trusted_defconfig"
U_BOOT_BIN:stm32mp15x = "u-boot.stm32"

IMAGE_FSTYPES ?= "wic"
WKS_FILE ?= "stm32mp15x.wks.in"
IMAGER_INSTALL:wic += "trusted-firmware-a-stm32mp15x optee-os-stm32mp15x u-boot-stm32mp15x"
IMAGER_BUILD_DEPS += "trusted-firmware-a-stm32mp15x optee-os-stm32mp15x u-boot-stm32mp15x"

IMAGE_INSTALL += "u-boot-script \
    optee-examples-stm32mp15x-acipher-host \
    optee-examples-stm32mp15x-aes-host \
    optee-examples-stm32mp15x-hello-world-host \
    optee-examples-stm32mp15x-hotp-host \
    optee-examples-stm32mp15x-random-host \
    optee-examples-stm32mp15x-secure-storage-host \
    initramfs-tee-supplicant-hook \
    initramfs-tee-ftpm-hook \
    "
```
