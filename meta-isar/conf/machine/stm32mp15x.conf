## meta-isar/conf/machine/stm32mp15x.conf
```bitbake
#
# Copyright (c) Siemens AG, 2020-2023
# Copyright (c) 2021-2026 ilbers GmbH
#
# SPDX-License-Identifier: MIT

DISTRO_ARCH ?= "armhf"

KERNEL_NAME ?= "mainline-${DISTRO_ARCH}"

U_BOOT_CONFIG:stm32mp15x = "stm32mp15_defconfig"
U_BOOT_BIN:stm32mp15x = "u-boot-nodtb.bin u-boot.dtb"

IMAGE_FSTYPES ?= "wic"
WKS_FILE ?= "stm32mp15x.wks.in"
IMAGER_INSTALL:wic += "trusted-firmware-a-stm32mp15x"
IMAGER_BUILD_DEPS += "trusted-firmware-a-stm32mp15x"

IMAGE_INSTALL += "u-boot-script \
    optee-examples-stm32mp15x-acipher-host \
    optee-examples-stm32mp15x-aes-host \
    optee-examples-stm32mp15x-hello-world-host \
    optee-examples-stm32mp15x-hotp-host \
    optee-examples-stm32mp15x-random-host \
    optee-examples-stm32mp15x-secure-storage-host \
    initramfs-tee-supplicant-hook \
    initramfs-tee-ftpm-hook \
    "

TEE_SUPPLICANT_IN_USERLAND = "1"
```
