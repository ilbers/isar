## meta-isar/conf/distro/ubuntu-focal.conf
```bitbake
#
# Copyright (c) Siemens AG, 2018-2020
#
# SPDX-License-Identifier: MIT

require conf/distro/ubuntu-common.inc

BASE_DISTRO_CODENAME = "focal"

DISTRO_GCC = "9"

DEBIAN_COMPAT = "12"

DEBIAN_STANDARDS_VERSION ?= "4.5.0"

DISTRO_APT_SOURCES:arm64 ?= "conf/distro/${BASE_DISTRO}-${BASE_DISTRO_CODENAME}-ports.list"
HOST_DISTRO_APT_SOURCES:arm64 ?= "conf/distro/${HOST_DISTRO}.list conf/distro/${HOST_DISTRO}-ports.list"
```

## meta-isar/conf/distro/ubuntu-jammy.conf
```bitbake
#
# Copyright (c) Siemens AG, 2018-2020
#
# SPDX-License-Identifier: MIT

require conf/distro/ubuntu-common.inc

BASE_DISTRO_CODENAME = "jammy"

DISTRO_GCC = "11"

DEBIAN_COMPAT = "13"

DEBIAN_STANDARDS_VERSION ?= "4.6.0"

DISTRO_APT_SOURCES:arm64 ?= "conf/distro/${BASE_DISTRO}-${BASE_DISTRO_CODENAME}-ports.list"
HOST_DISTRO_APT_SOURCES:arm64 ?= "conf/distro/${HOST_DISTRO}.list conf/distro/${HOST_DISTRO}-ports.list"
```

## meta-isar/conf/distro/ubuntu-noble.conf
```bitbake
#
# Copyright (c) Siemens AG, 2024
#
# SPDX-License-Identifier: MIT

require conf/distro/ubuntu-common.inc

BASE_DISTRO_CODENAME = "noble"

DISTRO_GCC = "13"

DEBIAN_COMPAT = "13"

DEBIAN_STANDARDS_VERSION ?= "4.7.0"

DISTRO_APT_SOURCES:arm64 ?= "conf/distro/${BASE_DISTRO}-${BASE_DISTRO_CODENAME}-ports.list"
HOST_DISTRO_APT_SOURCES:arm64 ?= "conf/distro/${HOST_DISTRO}.list conf/distro/${HOST_DISTRO}-ports.list"
```

## meta-isar/conf/machine/hyper-v-amd64.conf
```bitbake
# This software is a part of Isar.
# Copyright (C) Siemens AG, 2026
#
# SPDX-License-Identifier: MIT

DISTRO_ARCH ?= "amd64"

KERNEL_NAME ?= "amd64"

WKS_FILE ?= "sdimage-efi"

IMAGER_INSTALL:wic += "${GRUB_BOOTLOADER_INSTALL}"

IMAGE_FSTYPES ?= "ova"
VMDK_SUBFORMAT = "monolithicSparse"
VIRTUAL_MACHINE_IMAGE_TYPE = "vhdx"
```

## meta-isar/conf/machine/rpi-arm-v7l.conf
```bitbake
# This software is a part of Isar.
# Copyright (C) 2022,2026 ilbers GmbH

DISTRO_ARCH ?= "armhf"
KERNEL_NAME = "kernel7l"

include conf/machine/rpi-common.conf

KERNEL_IMAGE_PKG:trixie = "linux-image-rpi-v7"
KERNEL_HEADERS_PKG:trixie = "linux-headers-rpi-v7"
```

## meta-isar/conf/machine/rpi-arm.conf
```bitbake
# This software is a part of Isar.
# Copyright (C) 2022,2026 ilbers GmbH

DISTRO_ARCH ?= "armhf"
KERNEL_NAME = "kernel"

include conf/machine/rpi-common.conf

KERNEL_IMAGE_PKG:trixie = "linux-image-rpi-v6"
KERNEL_HEADERS_PKG:trixie = "linux-headers-rpi-v6"
```

## meta-isar/conf/machine/rpi-arm64-v8.conf
```bitbake
# This software is a part of Isar.
# Copyright (C) 2022,2026 ilbers GmbH

DISTRO_ARCH ?= "arm64"
KERNEL_NAME = "kernel8"

include conf/machine/rpi-common.conf

KERNEL_IMAGE_PKG:trixie = "linux-image-rpi-v8"
KERNEL_HEADERS_PKG:trixie = "linux-headers-rpi-v8"
```

## meta-isar/conf/machine/rpi-common.conf
```bitbake
# This software is a part of Isar.
# Copyright (C) 2023 ilbers GmbH

BOOT_SPACE ?= "81920"
MACHINE_SERIAL ?= "serial0"
BAUDRATE_TTY ?= "115200"

IMAGE_FSTYPES ?= "wic"
WKS_FILE ?= "rpi-sdimg"
INSTALLER_WKS_FILE ?= "installer-rpi.wks"

# RPi have custom kernel file names
KERNEL_FILE = "${KERNEL_NAME}.img"

KERNEL_TYPE = "raspios"
KERNEL_IMAGE_PKG ?= "raspberrypi-kernel"
KERNEL_HEADERS_PKG ?= "raspberrypi-kernel-headers"

IMAGE_PREINSTALL += "raspberrypi-sys-mods \
                     raspi-config \
                     systemd-sysv \
                     udev"

IMAGE_PREINSTALL:bullseye += "raspberrypi-bootloader"
IMAGE_PREINSTALL:bookworm += "raspberrypi-bootloader"
IMAGE_PREINSTALL:trixie += "raspi-firmware"

IMAGE_INSTALL += "bootconfig-${MACHINE}"

IMAGER_INSTALL:wic += "parted \
                       dosfstools \
                       mtools \
                       e2fsprogs \
                       bmap-tools"

IMAGER_INSTALL:bullseye:wic += "python3-distutils"
IMAGER_INSTALL:bookworm:wic += "python3-distutils"
IMAGER_INSTALL:trixie:wic += "python3-setuptools"

IMAGE_BOOT_FILES ?= "${IMAGE_ROOTFS}/boot/*.*;./ \
                     ${IMAGE_ROOTFS}/boot/overlays/*;overlays/"

IMAGE_BOOT_FILES:trixie ?= "${IMAGE_ROOTFS}/boot/cmdline.txt;./ \
                            ${IMAGE_ROOTFS}/boot/config.txt;./ \
                            ${IMAGE_ROOTFS}/boot/firmware/*.*;./ \
                            ${IMAGE_ROOTFS}/boot/firmware/overlays/*;overlays/"
```

## meta-isar/conf/machine/wsl.conf
```bitbake
# This software is a part of Isar.
# Copyright (C) Siemens AG, 2026
#
# SPDX-License-Identifier: MIT

DISTRO_ARCH ?= "amd64"

IMAGE_FSTYPES ?= "wsl"

# Configure rootfs for WSL boot
IMAGE_INSTALL:append = " wsl-config"
# Enable systemd-user session model
IMAGE_PREINSTALL:append = " dbus dbus-user-session"
```
