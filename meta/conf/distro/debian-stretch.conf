## meta/conf/distro/debian-stretch.conf
```bitbake
# This software is a part of ISAR.
# Copyright (C) 2017 ilbers GmbH

require debian-common.conf

BASE_DISTRO_CODENAME = "stretch"

HOST_DISTRO ?= "debian-stretch"

DISTRO_CONFIG_SCRIPT ?= "debian-configscript.sh"
DISTRO_KERNELS ?= "4kc-malta 586 5kc-malta 686 686-pae amd64 arm64 armmp \
    armmp-lpae kirkwood loongson-3 marvell octeon orion5x powerpc64le \
    rt-686-pae rt-amd64 s390x"

WIC_IMAGER_INSTALL += "python3"
WIC_IMAGER_INSTALL_remove = "fdisk"
WIC_IMAGER_INSTALL_remove = "python3-distutils"
```

## meta/conf/distro/debian-trixie.conf
```bitbake
# This software is a part of Isar.
# Copyright (C) 2024 ilbers GmbH
#
# SPDX-License-Identifier: MIT

require debian-common.conf

BASE_DISTRO_CODENAME = "trixie"

HOST_DISTRO ?= "debian-${BASE_DISTRO_CODENAME}"

DISTRO_CONFIG_SCRIPT ?= "debian-configscript.sh"
DISTRO_KERNELS ?= "5kc-malta amd64 arm64 armmp armmp-lpae cloud-amd64 \
        cloud-arm64 loongson-3 mips64r2el mips64r6el octeon powerpc64le \
        powerpc64le-64k riscv64 rpi rt-amd64 rt-arm64 rt-armmp s390x"

DISTRO_GCC = "13"

DEBIAN_COMPAT = "13"
```

## meta/conf/layer.conf
```bitbake
# This software is a part of ISAR.
# Copyright (C) 2015-2016 ilbers GmbH

# We have a conf and classes directory, add to BBPATH
BBPATH .= ":${LAYERDIR}"

# We have recipes-* directories, add to BBFILES
BBFILES +=  "${LAYERDIR}/recipes-*/*/*.bb"

BBFILE_COLLECTIONS += "core"
BBFILE_PATTERN_core = "^${LAYERDIR}/"
BBFILE_PRIORITY_core = "5"

LAYERSERIES_CORENAMES = "v0.6"

# This should only be incremented on significant changes that will
# cause compatibility issues with other layers
LAYERVERSION_core = "1"
LAYERSERIES_COMPAT_core = "v0.6"

LAYERDIR_core = "${LAYERDIR}"
```
