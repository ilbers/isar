## Kconfig
```kconfig
# This software is a part of ISAR.
# Copyright (C) 2023 ilbers GmbH
#
# Authors:
#  Uladzimir Bely <ubely@ilbers.de>

mainmenu "Isar configuration"

config KAS_INCLUDE_MAIN
	string
	default "kas/isar.yaml"

config KAS_BUILD_SYSTEM
	string
	default "isar"

source "kas/distro/Kconfig"
source "kas/machine/Kconfig"
source "kas/opt/Kconfig"
```

## kas/distro/Kconfig
```kconfig
# This software is a part of Isar.
# Copyright (C) 2023-2024 ilbers GmbH
#
# SPDX-License-Identifier: MIT
#
# Authors:
#  Uladzimir Bely <ubely@ilbers.de>

menu "Distro selection"

config DISTRO_DEBIAN
	bool

config DISTRO_RASPIOS
	bool

config DISTRO_UBUNTU
	bool

config CODENAME_BUSTER
	bool

config CODENAME_BULLSEYE
	bool

config CODENAME_BOOKWORM
	bool

config CODENAME_TRIXIE
	bool

config CODENAME_SID
	bool

config CODENAME_FOCAL
	bool

config CODENAME_JAMMY
	bool

config CODENAME_NOBLE
	bool

choice
	prompt "Distro selection"
	default DEBIAN_BOOKWORM

config DEBIAN_BUSTER
	bool "Debian 10 (buster)"
	depends on (DISTRO_DEBIAN && CODENAME_BUSTER) || ANY_MACHINE_DISTRO

config DEBIAN_BULLSEYE
	bool "Debian 11 (bullseye)"
	depends on (DISTRO_DEBIAN && CODENAME_BULLSEYE) || ANY_MACHINE_DISTRO

config DEBIAN_BOOKWORM
	bool "Debian 12 (bookworm)"
	depends on (DISTRO_DEBIAN && CODENAME_BOOKWORM) || ANY_MACHINE_DISTRO

config DEBIAN_TRIXIE
	bool "Debian 13 (trixie)"
	depends on (DISTRO_DEBIAN && CODENAME_TRIXIE) || ANY_MACHINE_DISTRO

config DEBIAN_SID
	bool "Debian Sid (unstable)"
	depends on (DISTRO_DEBIAN && CODENAME_SID) || ANY_MACHINE_DISTRO

config RASPIOS_BULLSEYE
	bool "Raspberry Pi OS Debian 11 (bullseye)"
	depends on (DISTRO_RASPIOS && CODENAME_BULLSEYE) || ANY_MACHINE_DISTRO

config RASPIOS_BOOKWORM
	bool "Raspberry Pi OS Debian 12 (bookworm)"
	depends on (DISTRO_RASPIOS && CODENAME_BOOKWORM) || ANY_MACHINE_DISTRO

config UBUNTU_FOCAL
	bool "Ubuntu 20.04 (Focal)"
	depends on (DISTRO_UBUNTU && CODENAME_FOCAL) || ANY_MACHINE_DISTRO

config UBUNTU_JAMMY
	bool "Ubuntu 22.04 (Jammy)"
	depends on (DISTRO_UBUNTU && CODENAME_JAMMY) || ANY_MACHINE_DISTRO

config UBUNTU_NOBLE
	bool "Ubuntu 24.04 (Noble)"
	depends on (DISTRO_UBUNTU && CODENAME_NOBLE) || ANY_MACHINE_DISTRO

endchoice

config ANY_MACHINE_DISTRO
	bool "Allow any machine-distro combinations"
	default n
	help
	  This allows to select any machine-distro combinations some of which
	  may be not bootable or even buildable.

config KAS_INCLUDE_DISTRO
	string
	default "kas/distro/debian-buster.yaml" if DEBIAN_BUSTER
	default "kas/distro/debian-bullseye.yaml" if DEBIAN_BULLSEYE
	default "kas/distro/debian-bookworm.yaml" if DEBIAN_BOOKWORM
	default "kas/distro/debian-trixie.yaml" if DEBIAN_TRIXIE
	default "kas/distro/debian-sid.yaml" if DEBIAN_SID
	default "kas/distro/raspios-bullseye.yaml" if RASPIOS_BULLSEYE
	default "kas/distro/raspios-bookworm.yaml" if RASPIOS_BOOKWORM
	default "kas/distro/ubuntu-focal.yaml" if UBUNTU_FOCAL
	default "kas/distro/ubuntu-jammy.yaml" if UBUNTU_JAMMY
	default "kas/distro/ubuntu-noble.yaml" if UBUNTU_NOBLE

endmenu
```

## kas/image/Kconfig
```kconfig
# This software is a part of ISAR.
# Copyright (C) 2023 ilbers GmbH
#
# Authors:
#  Uladzimir Bely <ubely@ilbers.de>

menu "Image type selection"

choice
	prompt "Image type selection"
	default IMAGE_BASE

config IMAGE_BASE
	bool "Base image"
	help
	  This is the basic Isar image with bare minimum of preinstalled packages.
	  It's technically close do the debootstrapped system with packages
	  required to boot up the system.

config IMAGE_DEBUG
	bool "Debug image"
	help
	  This image includes some tools preinstalled useful for debug.

config IMAGE_CI
	bool "CI image"
	select PACKAGE_SSHD_REGEN_KEYS
	select PACKAGE_ISAR_CI_SSH_SETUP
	help
	  This image includes is for running CI. Via isar-ci-ssh-setup recipe.
	  It creates ci user with non-interactive ssh access to the board.

config IMAGE_INSTALLER
	bool "Installer image"
	help
	  This image contains a target image and scripts to install the target image on a device.

endchoice

config KAS_INCLUDE_IMAGE
	string
	default "kas/image/isar-image-base.yaml" if IMAGE_BASE
	default "kas/image/isar-image-debug.yaml" if IMAGE_DEBUG
	default "kas/image/isar-image-ci.yaml" if IMAGE_CI
	default "kas/image/isar-image-installer.yaml" if IMAGE_INSTALLER

if IMAGE_INSTALLER
menu "Installer config"

source "kas/installer/Kconfig"

endmenu
endif

endmenu
```

## kas/installer/Kconfig
```kconfig
# This software is a part of ISAR.
# Copyright (C) Siemens AG, 2025
#
# SPDX-License-Identifier: MIT

config KAS_INCLUDE_IMAGE
	string
	default "kas/image/isar-image-installer.yaml"

comment "Images to bundle"

config BUNDLE_IMAGE_BASE
	bool "Base image"
	default y
	help
	  Embed the basic Isar image into the installer image.

config BUNDLE_IMAGE_CI
	bool "CI image"
	help
	  Embed the Isar CI image into the installer image.

config BUNDLE_IMAGE_DEBUG
	bool "Debug image"
	help
	  Embed the Isar debug image into the installer image.

comment "No installer payload. Copy image(s) manually to the INSTALLDATA partition"
	depends on !BUNDLE_IMAGE_BASE && !BUNDLE_IMAGE_CI && !BUNDLE_IMAGE_DEBUG

config INSTALL_UNATTENDED
	bool "Run installer unattended"
	depends on BUNDLE_IMAGE_BASE || BUNDLE_IMAGE_CI || BUNDLE_IMAGE_DEBUG

config INSTALLER_TARGET_IMAGE_BASE
	string
	default "isar-image-base" if BUNDLE_IMAGE_BASE

config INSTALLER_TARGET_IMAGE_CI
	string
	default "isar-image-ci" if BUNDLE_IMAGE_CI

config INSTALLER_TARGET_IMAGE_DEBUG
	string
	default "isar-image-debug" if BUNDLE_IMAGE_DEBUG

if INSTALL_UNATTENDED

config KAS_INCLUDE_INSTALLER_UNATTENDED
	string
	default "kas/installer/unattended.yaml"

config INSTALLER_UNATTENDED
	string
	default "1" if INSTALL_UNATTENDED
	default ""

choice
	prompt "Image to install unattended"

config INSTALL_IMAGE_BASE
	bool "Base image"
	depends on BUNDLE_IMAGE_BASE
	help
	  Install the basic Isar image in unattended mode.

config INSTALL_IMAGE_CI
	bool "CI image"
	depends on BUNDLE_IMAGE_CI
	help
	  Install the Isar CI image in unattended mode.

config INSTALL_IMAGE_DEBUG
	bool "Debug image"
	depends on BUNDLE_IMAGE_DEBUG
	help
	  Install the Isar debug image in unattended mode.

endchoice

config INSTALLER_TARGET_IMAGE
	string
	default "isar-image-base" if INSTALL_IMAGE_BASE
	default "isar-image-ci" if INSTALL_IMAGE_CI
	default "isar-image-debug" if INSTALL_IMAGE_DEBUG


config INSTALLER_TARGET_DEVICE
	string "Target device to deploy"
	default "/dev/sda"
	help
          Deploy image to this target device. Accepts comma/colon-separated multiple devices; installs on the first available.
	  Leave this empty to get prompted during installation
	  Examples: /dev/sda, /dev/nvme0n1, /dev/sda:/dev/nvme0n1

choice
	prompt "Overwrite handling"
	default OPT_INSTALLER_TARGET_OVERWRITE

config OPT_INSTALLER_TARGET_OVERWRITE
	bool "Overwrite if target is not empty"

config OPT_INSTALLER_TARGET_ABORT
	bool "Abort if target is not empty"

endchoice

config INSTALLER_TARGET_OVERWRITE
	string
	default "OVERWRITE" if OPT_INSTALLER_TARGET_OVERWRITE
	default "ABORT" if OPT_INSTALLER_TARGET_ABORT

config OPT_INSTALLER_UNATTENDED_ABORT_ENABLE
	bool "Allow aborting unattended installation"
	help
	  Allow users to abort unattended installation before it starts by
	  pressing a key during a configurable timeout, switching to normal
	  installation mode.

config INSTALLER_UNATTENDED_ABORT_ENABLE
	string
	default "1" if OPT_INSTALLER_UNATTENDED_ABORT_ENABLE

config INSTALLER_UNATTENDED_ABORT_TIMEOUT
	string "Unattended abort timeout (seconds)"
	depends on OPT_INSTALLER_UNATTENDED_ABORT_ENABLE
	default "5"
	help
	  Set the number of seconds users have to press a key to abort
	  unattended installation and switch to normal installation mode.

endif

config INSTALLER_ADD_DEVICE_INFO_COLLECTOR
        bool "Add Device Info Collector"
        default n

config KAS_INCLUDE_INSTALLER_ADD_DEVICE_INFO_COLLECTOR
	string
	default "kas/installer/add-device-info-collector.yaml"
    depends on INSTALLER_ADD_DEVICE_INFO_COLLECTOR

config TARGET_BOOTSTRAPPER_TTY_SERVICES
	string "TTY Service to use"
	default "getty@tty1 serial-getty@ttyS0" if !INSTALL_UNATTENDED
	default "serial-getty@ttyS0" if INSTALL_UNATTENDED
	help
          TTY Service(s) used to execute the installer on.
	  In case of unattended installers, make sure only one tty
	  is specified here, else race condition between installer
	  instances may occur.
	  Examples: "serial-getty@ttyS0", "getty@tty1" or combinations like "getty@tty1 serial-getty@ttyS0"
```

## kas/machine/Kconfig
```kconfig
# This software is a part of Isar.
# Copyright (C) 2023-2024 ilbers GmbH
#
# SPDX-License-Identifier: MIT
#
# Authors:
#  Uladzimir Bely <ubely@ilbers.de>

menu "Machine selection"

config ARCH_AMD64
	bool

config ARCH_ARM64
	bool

config ARCH_ARMHF
	bool

config ARCH_I386
	bool

config ARCH_MIPSEL
	bool

config ARCH_RISCV64
	bool

choice
	prompt "Machine selection"
	default MACHINE_QEMU_AMD64

config MACHINE_BANANAPI
	bool "bananapi"
	select DISTRO_DEBIAN
	select CODENAME_BUSTER
	select CODENAME_BULLSEYE
	select CODENAME_BOOKWORM
	select ARCH_ARMHF

config MACHINE_BEAGLEPLAY
	bool "beagleplay"
	select DISTRO_DEBIAN
	select CODENAME_BOOKWORM
	select ARCH_ARM64

config MACHINE_CONTAINER_AMD64
	bool "container-amd64"
	select DISTRO_DEBIAN
	select CODENAME_BUSTER
	select CODENAME_BULLSEYE
	select CODENAME_BOOKWORM
	select ARCH_AMD64

config MACHINE_DE0_NANO_SOC
	bool "de0-nano-soc"
	select DISTRO_DEBIAN
	select CODENAME_BUSTER
	select CODENAME_BULLSEYE
	select CODENAME_BOOKWORM
	select ARCH_ARMHF

config MACHINE_HIKEY
	bool "hikey"
	select DISTRO_DEBIAN
	select CODENAME_BULLSEYE
	select CODENAME_BOOKWORM
	select ARCH_ARM64

config MACHINE_IMX6_SABRELITE
	bool "imx6-sabrelite"
	select DISTRO_DEBIAN
	select CODENAME_BUSTER
	select CODENAME_BULLSEYE
	select ARCH_ARMHF

config MACHINE_NANOPI_NEO
	bool "nanopi-neo"
	select DISTRO_DEBIAN
	select CODENAME_BUSTER
	select CODENAME_BULLSEYE
	select CODENAME_BOOKWORM
	select ARCH_ARMHF

config MACHINE_NANOPI_NEO_EFI
	bool "nanopi-neo-efi"
	select DISTRO_DEBIAN
	select CODENAME_BOOKWORM
	select ARCH_ARMHF

config MACHINE_PHYBOARD_MIRA
	bool "phyboard-mira"
	select DISTRO_DEBIAN
	select CODENAME_BULLSEYE
	select CODENAME_BOOKWORM
	select ARCH_ARMHF

config MACHINE_QEMU_AMD64_CIP
	bool "qemuamd64-cip"
	select DISTRO_DEBIAN
	select CODENAME_BOOKWORM
	select ARCH_AMD64

config MACHINE_QEMU_AMD64_SB
	bool "qemuamd64-sb"
	select CODENAME_BULLSEYE
	select ARCH_AMD64

config MACHINE_QEMU_AMD64
	bool "qemuamd64"
	select DISTRO_DEBIAN
	select CODENAME_BUSTER
	select CODENAME_BULLSEYE
	select CODENAME_BOOKWORM
	select CODENAME_TRIXIE
	select DISTRO_UBUNTU
	select CODENAME_FOCAL
	select CODENAME_JAMMY
	select CODENAME_NOBLE
	select ARCH_AMD64

config MACHINE_QEMU_ARM
	bool "qemuarm"
	select DISTRO_DEBIAN
	select CODENAME_BUSTER
	select CODENAME_BULLSEYE
	select CODENAME_BOOKWORM
	select CODENAME_TRIXIE
	select ARCH_ARMHF

config MACHINE_QEMU_ARM64
	bool "qemuarm64"
	select DISTRO_DEBIAN
	select CODENAME_BUSTER
	select CODENAME_BULLSEYE
	select CODENAME_BOOKWORM
	select CODENAME_TRIXIE
	select DISTRO_UBUNTU
	select CODENAME_FOCAL
	select CODENAME_JAMMY
	select CODENAME_NOBLE
	select ARCH_ARM64

config MACHINE_QEMU_I386
	bool "qemui386"
	select DISTRO_DEBIAN
	select CODENAME_BUSTER
	select CODENAME_BULLSEYE
	select CODENAME_BOOKWORM
	select ARCH_I386

config MACHINE_QEMU_MIPSEL
	bool "qemumipsel"
	select DISTRO_DEBIAN
	select CODENAME_BULLSEYE
	select CODENAME_BOOKWORM
	select ARCH_MIPSEL

config MACHINE_QEMU_RISCV64
	bool "qemuriscv64"
	select DISTRO_DEBIAN
	select CODENAME_TRIXIE
	select CODENAME_SID
	select ARCH_RISCV64

config MACHINE_RPI_ARM_V7
	bool "rpi-arm-v7"
	select DISTRO_RASPIOS
	select CODENAME_BULLSEYE
	select CODENAME_BOOKWORM
	select ARCH_ARMHF

config MACHINE_RPI_ARM_V7L
	bool "rpi-arm-v7l"
	select DISTRO_RASPIOS
	select CODENAME_BULLSEYE
	select CODENAME_BOOKWORM
	select ARCH_ARMHF

config MACHINE_RPI_ARM
	bool "rpi-arm"
	select DISTRO_RASPIOS
	select CODENAME_BULLSEYE
	select CODENAME_BOOKWORM
	select ARCH_ARMHF

config MACHINE_RPI_ARM64_V8
	bool "rpi-arm64-v8"
	select DISTRO_RASPIOS
	select CODENAME_BULLSEYE
	select CODENAME_BOOKWORM
	select ARCH_ARM64

config MACHINE_SIFIVE_FU540
	bool "sifive-fu540"
	select DISTRO_DEBIAN
	select CODENAME_TRIXIE
	select CODENAME_SID
	select ARCH_RISCV64

config MACHINE_STARFIVE_VISIONFIVE2
	bool "starfive-visionfive2"
	select DISTRO_DEBIAN
	select CODENAME_TRIXIE
	select CODENAME_SID
	select ARCH_RISCV64

config MACHINE_STM32MP15X
	bool "stm32mp15x"
	select DISTRO_DEBIAN
	select CODENAME_BULLSEYE
	select ARCH_ARMHF

config MACHINE_VIRTUALBOX
	bool "virtualbox"
	select DISTRO_DEBIAN
	select CODENAME_BULLSEYE
	select CODENAME_BOOKWORM
	select ARCH_AMD64

config MACHINE_VMWARE
	bool "vmware"
	select DISTRO_DEBIAN
	select CODENAME_BULLSEYE
	select ARCH_AMD64

config MACHINE_X86_PC
	bool "x86 PC"
	select DISTRO_DEBIAN
	select CODENAME_BULLSEYE
	select CODENAME_BOOKWORM
	select CODENAME_TRIXIE
	select DISTRO_UBUNTU
	select CODENAME_FOCAL
	select CODENAME_JAMMY
	select CODENAME_NOBLE
	select ARCH_AMD64

endchoice

config KAS_INCLUDE_MACHINE
	string
	default "kas/machine/bananapi.yaml" if MACHINE_BANANAPI
	default "kas/machine/beagleplay.yaml" if MACHINE_BEAGLEPLAY
	default "kas/machine/container-amd64.yaml" if MACHINE_CONTAINER_AMD64
	default "kas/machine/de0-nano-soc.yaml" if MACHINE_DE0_NANO_SOC
	default "kas/machine/hikey.yaml" if MACHINE_HIKEY
	default "kas/machine/imx6-sabrelite.yaml" if MACHINE_IMX6_SABRELITE
	default "kas/machine/nanopi-neo.yaml" if MACHINE_NANOPI_NEO
	default "kas/machine/nanopi-neo-efi.yaml" if MACHINE_NANOPI_NEO_EFI
	default "kas/machine/phyboard-mira.yaml" if MACHINE_PHYBOARD_MIRA
	default "kas/machine/qemuamd64-cip.yaml" if MACHINE_QEMU_AMD64_CIP
	default "kas/machine/qemuamd64-sb.yaml" if MACHINE_QEMU_AMD64_SB
	default "kas/machine/qemuamd64.yaml" if MACHINE_QEMU_AMD64
	default "kas/machine/qemuarm.yaml" if MACHINE_QEMU_ARM
	default "kas/machine/qemuarm64.yaml" if MACHINE_QEMU_ARM64
	default "kas/machine/qemui386.yaml" if MACHINE_QEMU_I386
	default "kas/machine/qemumipsel.yaml" if MACHINE_QEMU_MIPSEL
	default "kas/machine/qemuriscv64.yaml" if MACHINE_QEMU_RISCV64
	default "kas/machine/rpi-arm-v7.yaml" if MACHINE_RPI_ARM_V7
	default "kas/machine/rpi-arm-v7l.yaml" if MACHINE_RPI_ARM_V7L
	default "kas/machine/rpi-arm.yaml" if MACHINE_RPI_ARM
	default "kas/machine/rpi-arm64-v8.yaml" if MACHINE_RPI_ARM64_V8
	default "kas/machine/sifive-fu540.yaml" if MACHINE_SIFIVE_FU540
	default "kas/machine/starfive-visionfive2.yaml" if MACHINE_STARFIVE_VISIONFIVE2
	default "kas/machine/stm32mp15x.yaml" if MACHINE_STM32MP15X
	default "kas/machine/virtualbox.yaml" if MACHINE_VIRTUALBOX
	default "kas/machine/vmware.yaml" if MACHINE_VMWARE
	default "kas/machine/x86-pc.yaml" if MACHINE_X86_PC

endmenu
```
