## kas/opt/Kconfig
```kconfig
# This software is a part of ISAR.
# Copyright (C) 2023-2024 ilbers GmbH
# Copyright (C) 2024 Siemens AG
#
# Authors:
#  Uladzimir Bely <ubely@ilbers.de>
#
# SPDX-License-Identifier: MIT

menu "Mirror selection"
	depends on DEBIAN_BUSTER || DEBIAN_BULLSEYE || DEBIAN_BOOKWORM || DEBIAN_TRIXIE || DEBIAN_SID || UBUNTU_FOCAL || UBUNTU_JAMMY || UBUNTU_NOBLE

config MIRROR_DEBIAN
	bool "Use specific Debian mirror"
	depends on DEBIAN_BUSTER || DEBIAN_BULLSEYE || DEBIAN_BOOKWORM || DEBIAN_TRIXIE || DEBIAN_SID
	help
	  Select better local Debian mirror instead of deb.debian.org

config MIRROR_DEBIAN_URL
	string "URL of Debian mirror"
	default "http://deb.debian.org"
	depends on MIRROR_DEBIAN

config KAS_INCLUDE_MIRROR_DEBIAN
	string
	default "kas/opt/mirror-debian.yaml"
	depends on MIRROR_DEBIAN


config MIRROR_UBUNTU
	bool "Use specific Ubuntu mirror"
	depends on UBUNTU_FOCAL || UBUNTU_JAMMY
	help
	  Select better local Ubuntu mirror instead of archive.ubuntu.com

config MIRROR_UBUNTU_URL
	string "URL of Ubuntu mirror"
	default "http://archive.ubuntu.com"
	depends on MIRROR_UBUNTU

config KAS_INCLUDE_MIRROR_UBUNTU
	string
	default "kas/opt/mirror-ubuntu.yaml"
	depends on MIRROR_UBUNTU

config USE_APT_SNAPSHOT
	bool "Use the distros snapshot mirror"
	depends on !MIRROR_DEBIAN && (DEBIAN_BUSTER || DEBIAN_BULLSEYE || DEBIAN_BOOKWORM || DEBIAN_TRIXIE || DEBIAN_SID || UBUNTU_FOCAL || UBUNTU_JAMMY || UBUNTU_NOBLE)
	help
		Use a snapshot mirror for the selected distribution.

choice
	prompt "Snapshot date"
	depends on USE_APT_SNAPSHOT
	default APT_SNAPSHOT_GIT_DATE

config APT_SNAPSHOT_GIT_DATE
	bool "Timestamp of latest git commit"

config APT_SNAPSHOT_CUSTOM_DATE
	bool "Custom date"

endchoice

config ISAR_APT_SNAPSHOT_DATE
	string "Custom snapshot date"
	depends on APT_SNAPSHOT_CUSTOM_DATE
	default "20240211T000000Z"

config KAS_INCLUDE_APT_SNAPSHOT
	string
	default "kas/opt/mirror-snapshot.yaml"
	depends on USE_APT_SNAPSHOT

endmenu


menu "User management"

config USER_ROOT
	bool "Activate 'root' user"
	help
	  Enables root user.

config KAS_USER_ROOT_PASSWORD
	string "Password for 'root' user"
	default "root"
	depends on USER_ROOT
	help
	  Set password for 'root' user.

config KAS_INCLUDE_USER_ROOT
	string
	default "kas/opt/user-root.yaml"
	depends on USER_ROOT


config USER_ISAR
	bool "Activate 'isar' user"
	default y
	help
	  Enables `isar` user.

config KAS_USER_ISAR_PASSWORD
	string "Password for 'isar' user"
	default "isar"
	depends on USER_ISAR
	help
	  Set password for 'isar' user.

config KAS_INCLUDE_USER_ISAR
	string
	default "kas/opt/user-isar.yaml"
	depends on USER_ISAR

endmenu

config KAS_IMAGE_FSTYPES
	string "Additional image fstypes"
	default ""
	help
	  Space-separated list of additional image fstypes to generate. Default
	  machine configurations set up IMAGE_FSTYPES variable, but it's possible
	  to select additonal ones to generate.
	  The following IMAGE_FSTYPES are supported:
	    cpio
	    fit
	    docker-archive
	    ext4
	    ova
	    tar
	    ubi
	    ubifs
	    wic
	  They can be followed by suffixes like ".gz" for compressing the image

config KAS_INCLUDE_IMAGE_FSTYPES
	string
	default "kas/opt/image-fstypes.yaml"


config COMPAT_ARCH
	bool "Enable compat arch support"

config KAS_INCLUDE_COMPAT_ARCH
	string
	default "kas/opt/compat-arch.yaml"
	depends on COMPAT_ARCH


config ISAR_CROSS_COMPILE
	bool "Enable cross compilation mode"
	default y

config KAS_ISAR_CROSS_COMPILE
	string
	default "1" if ISAR_CROSS_COMPILE
	default "0" if !ISAR_CROSS_COMPILE

config KAS_INCLUDE_ISAR_CROSS_COMPILE
	string
	default "kas/opt/crosscompile.yaml"


config USE_CCACHE
	bool "Use ccache during build"
	default y

config KAS_INCLUDE_USE_CCACHE
	string
	default "kas/opt/ccache.yaml"
	depends on USE_CCACHE


config CACHE_DEB_SRC
	bool "Cache all source packages"
	help
	  This feature allows to download srcpackages for any binary package that
	  took part in the build (including ones downloaded from distro mirrors).

config KAS_INCLUDE_CACHE_DEB_SRC
	string
	default "kas/opt/cache-deb-src.yaml"
	depends on CACHE_DEB_SRC


config CACHE_DBG_PKGS
	bool "Cache all debug packages"
	help
	  This feature allows to download debug symbol packages for any binary package
	  that took part in the build (including ones downloaded from distro mirrors).

config KAS_INCLUDE_CACHE_DBG_PKGS
	string
	default "kas/opt/cache-dbg-pkgs.yaml"
	depends on CACHE_DBG_PKGS

config USE_DRACUT
	bool "Use dracut to generate the initramfs"
	help
          This feature enables generating the initramfs using the dracut tool

config KAS_INCLUDE_USE_DRACUT
	string
	default "kas/opt/dracut.yaml"
	depends on USE_DRACUT
```

## kas/package/Kconfig
```kconfig
# This software is a part of Isar.
# Copyright (C) 2023-2024 ilbers GmbH
#
# Authors:
#  Uladzimir Bely <ubely@ilbers.de>

menu "Packages selection"

menu "Isar packages"

config PACKAGE_COWSAY
        bool "cowsay"
        default y

config KAS_INCLUDE_PACKAGE_COWSAY
        string
        default "kas/package/pkg_cowsay.yaml"
        depends on PACKAGE_COWSAY


config PACKAGE_ENABLE_FSCK
        bool "enable-fsck"
        default y

config KAS_INCLUDE_PACKAGE_ENABLE_FSCK
        string
        default "kas/package/pkg_enable-fsck.yaml"
        depends on PACKAGE_ENABLE_FSCK


config PACKAGE_EXAMPLE_RAW
        bool "example-raw"
        default y

config KAS_INCLUDE_PACKAGE_EXAMPLE_RAW
        string
        default "kas/package/pkg_example-raw.yaml"
        depends on PACKAGE_EXAMPLE_RAW


config PACKAGE_EXAMPLE_MODULE
        bool "example-module"
        default y
        depends on !MACHINE_CONTAINER_AMD64

config KAS_INCLUDE_PACKAGE_EXAMPLE_MODULE
        string
        default "kas/package/pkg_example-module.yaml"
        depends on PACKAGE_EXAMPLE_MODULE


config PACKAGE_EXAMPLE_PREBUILT
        bool "example-prebuilt"
        default y

config KAS_INCLUDE_PACKAGE_EXAMPLE_PREBUILT
        string
        default "kas/package/pkg_example-prebuilt.yaml"
        depends on PACKAGE_EXAMPLE_PREBUILT


config PACKAGE_EXPAND_ON_FIRST_BOOT
        bool "expand-on-first-boot"
        default y
        depends on !MACHINE_QEMU_AMD64_ISO

config KAS_INCLUDE_PACKAGE_EXPAND_ON_FIRST_BOOT
        string
        default "kas/package/pkg_expand-on-first-boot.yaml"
        depends on PACKAGE_EXPAND_ON_FIRST_BOOT


config PACKAGE_HELLO
        bool "hello"
        default y

config KAS_INCLUDE_PACKAGE_HELLO
        string
        default "kas/package/pkg_hello.yaml"
        depends on PACKAGE_HELLO


config PACKAGE_HELLO_ISAR
        bool "hello-isar"
        default y

config KAS_INCLUDE_PACKAGE_HELLO_ISAR
        string
        default "kas/package/pkg_hello-isar.yaml"
        depends on PACKAGE_HELLO_ISAR


config PACKAGE_ISAR_EXCLUDE_DOCS
        bool "isar-exclude-docs"
        default y

config KAS_INCLUDE_PACKAGE_ISAR_EXCLUDE_DOCS
        string
        default "kas/package/pkg_isar-exclude-docs.yaml"
        depends on PACKAGE_ISAR_EXCLUDE_DOCS


config PACKAGE_ISAR_DISABLE_APT_CACHE
        bool "isar-disable-apt-cache"
        default y

config KAS_INCLUDE_PACKAGE_ISAR_DISABLE_APT_CACHE
        string
        default "kas/package/pkg_isar-disable-apt-cache.yaml"
        depends on PACKAGE_ISAR_DISABLE_APT_CACHE


config PACKAGE_KSELFTEST
        bool "kselftest"
        default n

config KAS_INCLUDE_PACKAGE_KSELFTEST
        string
        default "kas/package/pkg_kselftest.yaml"
        depends on PACKAGE_KSELFTEST


config PACKAGE_SAMEFILE
        bool "samefile"
        default y

config KAS_INCLUDE_PACKAGE_SAMEFILE
        string
        default "kas/package/pkg_samefile.yaml"
        depends on PACKAGE_SAMEFILE


config PACKAGE_SSHD_REGEN_KEYS
        bool "sshd-regen-keys"
        default y

config KAS_INCLUDE_PACKAGE_SSHD_REGEN_KEYS
        string
        default "kas/package/pkg_sshd-regen-keys.yaml"
        depends on PACKAGE_SSHD_REGEN_KEYS

config PACKAGE_ISAR_CI_SSH_SETUP
        bool "isar-ci-ssh-setup"
        default n

config KAS_INCLUDE_PACKAGE_ISAR_CI_SSH_SETUP
        string
        default "kas/package/pkg_sshd-regen-keys.yaml"
        depends on PACKAGE_ISAR_CI_SSH_SETUP


config PACKAGE_PREBUILT_DOCKER_IMG
        bool "prebuilt-docker-img"
        default y
        depends on ARCH_AMD64 || ARCH_ARM64 || ARCH_ARM
        depends on !MACHINE_QEMU_AMD64_ISO

config KAS_INCLUDE_PACKAGE_PREBUILT_DOCKER_IMG
        string
        default "kas/package/pkg_prebuilt-docker-img.yaml"
        depends on PACKAGE_PREBUILT_DOCKER_IMG

config PACKAGE_PREBUILT_PODMAN_IMG
        bool "prebuilt-podman-img"
        default y
        depends on DEBIAN_BULLSEYE || DEBIAN_BOOKWORM || DEBIAN_TRIXIE || UBUNTU_JAMMY || UBUNTU_NOBLE
        depends on ARCH_AMD64 || ARCH_ARM64 || ARCH_ARM
        depends on !MACHINE_QEMU_AMD64_ISO

config KAS_INCLUDE_PACKAGE_PREBUILT_PODMAN_IMG
        string
        default "kas/package/pkg_prebuilt-podman-img.yaml"
        depends on PACKAGE_PREBUILT_PODMAN_IMG

endmenu

config KAS_IMAGE_PREINSTALL
	string "Distro packages"
	default "fdisk iproute2 iputils-ping isc-dhcp-client"
	help
	  Space-separated list of packages that are provided by the selected distro.
	  These packages are downloaded from distro mirrors and just unpacked
	  and configured by Isar.

config KAS_INCLUDE_PACKAGES_DISTRO
	string
	default "kas/package/packages-distro.yaml"

endmenu
```

## meta-isar-bin/conf/layer.conf
```bitbake
APTCACHE_ENABLED ?= "1"

APTCACHEDIR ?= "${LAYERDIR}/apt"
APTCACHEMNT ?= "/opt/cache/apt"
```

## meta-isar/conf/bblayers.conf.sample
```bitbake
# LAYER_CONF_VERSION is increased each time build/conf/bblayers.conf
# changes incompatibly
LCONF_VERSION = "6"

BBPATH = "${TOPDIR}"
BBFILES ?= ""

BBLAYERS ?= " \
  ##ISARROOT##/meta \
  ##ISARROOT##/meta-isar \
  ##ISARROOT##/meta-isar-bin \
  "
BBLAYERS_NON_REMOVABLE ?= " \
  ##ISARROOT##/meta \
  "
```

## meta-isar/conf/distro/debian-buster.conf
```bitbake
# This software is a part of ISAR.

require debian-common.conf

DISTRO_APT_SOURCES += "conf/distro/debian-buster.list"
DISTRO_CONFIG_SCRIPT ?= "debian-configscript.sh"
DISTRO_KERNELS ?= "4kc-malta 5kc-malta 686 686-pae amd64 arm64 armmp \
    armmp-lpae cloud-amd64 loongson-3 marvell octeon powerpc64le s390x"

WIC_IMAGER_INSTALL += "python3-distutils"
```

## meta-isar/conf/distro/debian-common.conf
```bitbake
# This software is a part of ISAR.
# Copyright (C) 2018 Siemens AG
#
# SPDX-License-Identifier: MIT

WIC_IMAGER_INSTALL = "parted \
                      gdisk \
                      util-linux \
                      dosfstools \
                      mtools \
                      e2fsprogs \
                      python3"

GRUB_BOOTLOADER_INSTALL_amd64 = "grub-efi-amd64-bin"
GRUB_BOOTLOADER_INSTALL_i386 = "grub-efi-ia32-bin"
GRUB_BOOTLOADER_INSTALL_armhf = "grub-efi-arm-bin"
GRUB_BOOTLOADER_INSTALL_arm64 = "grub-efi-arm64-bin"

SYSLINUX_BOOTLOADER_INSTALL = "syslinux syslinux-common"
```

## meta-isar/conf/distro/debian-jessie.conf
```bitbake
# Debian jessie distribution configuration
#
# This software is a part of ISAR.
# Copyright (C) 2015-2016 ilbers GmbH

DISTRO_APT_SOURCES += "conf/distro/debian-jessie.list"
DISTRO_CONFIG_SCRIPT ?= "debian-configscript.sh"
DISTRO_KERNELS ?= "486 4kc-malta 586 5kc-malta 686-pae amd64 arm64 armmp \
    armmp-lpae ixp4xx kirkwood loongson-2e loongson-2f loongson-3 octeon \
    orion5x powerpc powerpc-smp powerpc64 powerpc64le r4k-ip22 r5k-ip32 \
    s390x sb1-bcm91250a versatile"
```

## meta-isar/conf/distro/debian-stretch.conf
```bitbake
# This software is a part of ISAR.
# Copyright (C) 2017 ilbers GmbH

DISTRO_SUITE ?= "stretch"
DISTRO_COMPONENTS ?= "main contrib non-free"
DISTRO_APT_SOURCE ?= "http://ftp.debian.org/debian"
DISTRO_APT_SOURCE_SEC ?= "http://security.debian.org/debian-security"
DISTRO_CONFIG_SCRIPT ?= "debian-configscript.sh"
DISTRO_MULTICONF_BOOTSTRAP ?= "base updates security"
DISTRO_MULTICONF_APTSOURCES ?= "${DISTRO_MULTICONF_BOOTSTRAP}"
DISTRO_KERNELS ?= "4kc-malta 586 5kc-malta 686 686-pae amd64 arm64 armmp \
    armmp-lpae kirkwood loongson-3 marvell octeon orion5x powerpc64le \
    rt-686-pae rt-amd64 s390x"
```

## meta-isar/conf/distro/debian-wheezy.conf
```bitbake
# Debian wheezy distribution configuration
#
# This software is a part of ISAR.
# Copyright (C) 2015-2016 ilbers GmbH

DISTRO_APT_SOURCES += "conf/distro/debian-wheezy.list"
DISTRO_CONFIG_SCRIPT ?= "debian-configscript.sh"
DISTRO_KERNELS ?= "486 686-pae amd64 rt-686-pae rt-amd64 versatile vexpress \
    iop32x ixp4xx kirkwood mv78xx0 mx5 omap orion5x"
```

## meta-isar/conf/distro/raspbian-jessie.conf
```bitbake
# Raspbian stable distribution configuration
#
# This software is a part of ISAR.
# Copyright (C) 2015-2016 ilbers GmbH

BASE_DISTRO = "raspbian"
BASE_DISTRO_CODENAME = "jessie"

DISTRO_APT_SOURCES += "conf/distro/raspbian-jessie.list"
DISTRO_APT_KEYS += "https://archive.raspbian.org/raspbian.public.key;sha256sum=ca59cd4f2bcbc3a1d41ba6815a02a8dc5c175467a59bd87edeac458f4a5345de"
DISTRO_CONFIG_SCRIPT ?= "${LAYERDIR_isar}/conf/distro/raspbian-configscript.sh"
DISTRO_KERNELS ?= "rpi rpi2 rpi-rpfv rpi2-rpfv"
```

## meta-isar/conf/distro/raspios-bullseye.conf
```bitbake
# Raspbi OS stable distribution configuration
#
# This software is a part of ISAR.
# Copyright (C) 2022 ilbers GmbH

BASE_DISTRO = "raspios"
BASE_DISTRO_arm64 = "debian"

BASE_DISTRO_CODENAME = "bullseye"
HOST_DISTRO ?= "debian-bullseye"
HOST_DISTRO_APT_SOURCES ?= "conf/distro/${HOST_DISTRO}.list"

DISTRO_APT_SOURCES ?= "conf/distro/raspios-bullseye.list"
DISTRO_APT_SOURCES_arm64 ?= "conf/distro/raspios-bullseye-64.list"

DISTRO_BOOTSTRAP_KEYS = "http://raspbian.raspberrypi.org/raspbian.public.key;sha256sum=ca59cd4f2bcbc3a1d41ba6815a02a8dc5c175467a59bd87edeac458f4a5345de"
DISTRO_BOOTSTRAP_KEYS_arm64 = ""

DISTRO_CONFIG_SCRIPT ?= "${LAYERDIR_isar}/conf/distro/raspios-configscript.sh"
DISTRO_KERNELS ?= "kernel kernel7 kernel7l kernel8"

THIRD_PARTY_APT_KEYS += "http://archive.raspberrypi.org/debian/raspberrypi.gpg.key;sha256sum=76603890d82a492175caf17aba68dc73acb1189c9fd58ec0c19145dfa3866d56"

COMPAT_DISTRO_ARCH_arm64 = "armhf"
```

## meta-isar/conf/distro/ubuntu-common.inc
```bitbake
#
# Copyright (c) Siemens AG, 2018-2023
#
# SPDX-License-Identifier: MIT

require conf/distro/debian-common.conf

BASE_DISTRO = "ubuntu"

HOST_BASE_DISTRO = "${BASE_DISTRO}"

DISTRO_APT_SOURCES:arm64 ?= "conf/distro/${BASE_DISTRO}-${BASE_DISTRO_CODENAME}-ports.list"
HOST_DISTRO_APT_SOURCES:arm64 ?= "conf/distro/${HOST_DISTRO}.list conf/distro/${HOST_DISTRO}-ports.list"

BOOTSTRAP_KEY = "file://${LAYERDIR_isar}/conf/distro/ubuntu.public.key;sha256sum=36a38199a4bf4eae1e7f574891f7dfcb79b91b87a33a499383265e1224b5e989"
DISTRO_BOOTSTRAP_KEYS += "${BOOTSTRAP_KEY}"
HOST_DISTRO_BOOTSTRAP_KEYS += "${BOOTSTRAP_KEY}"

# kernel package name is linux-image-generic in Ubuntu
KERNEL_NAME = "generic"

# that is what debootstrap_1.0.118ubuntu1 does anyways
DISTRO_DEBOOTSTRAP_SCRIPT = "/usr/share/debootstrap/scripts/gutsy"

DISTRO_CONFIG_SCRIPT ?= "debian-configscript.sh"

DISTRO_KERNELS ?= " \
    aws azure azure-edge gcp generic gke kvm lowlatency oem virtual \
    snapdragon generic-lpae"

IMAGE_PREINSTALL += "init"
IMAGE_PREINSTALL += "initramfs-tools"

IMAGER_INSTALL:wic += "python3-distutils"

SYSTEMD_BOOTLOADER_INSTALL:focal = "systemd:${DISTRO_ARCH}"
SYSTEMD_BOOTLOADER_INSTALL:jammy = "systemd:${DISTRO_ARCH}"
```

## meta-isar/conf/distro/ubuntu-resolute.conf
```bitbake
# This software is a part of Isar.
# Copyright (C) 2026 ilbers GmbH
#
# SPDX-License-Identifier: MIT

require conf/distro/ubuntu-common.inc

BASE_DISTRO_CODENAME = "resolute"

DISTRO_GCC = "15"

DEBIAN_COMPAT = "13"

DEBIAN_STANDARDS_VERSION ?= "4.7.4"
```
